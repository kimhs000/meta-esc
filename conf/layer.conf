## conf/layer.conf
```bitbake
# We have a conf and classes directory, add to BBPATH
BBPATH .= ":${LAYERDIR}"

# We have recipes-* directories, add to BBFILES
BBFILES += "${LAYERDIR}/recipes-*/*/*.bb \
	${LAYERDIR}/recipes-*/*/*.bbappend"

BBFILE_COLLECTIONS += "esc"
BBFILE_PATTERN_esc = "^${LAYERDIR}/"
BBFILE_PRIORITY_esc = "6"

FSL_EULA_FILE = "${LAYERDIR}/EULA"
```

## conf/machine/imx6q-esc.conf
```bitbake
#@TYPE: Machine
#@NAME: Naimtechnology i.MX6Q ESC
#@SOC: i.MX6Q
#@DESCRIPTION: Machine configuration for Naimtechnology i.MX6Q ESC
#@MAINTAINER: HyuksooKim <kimhs@naimtechnology.com>

MACHINEOVERRIDES =. "mx6:mx6q:mx6dl:"

require conf/machine/include/imx-base.inc
require conf/machine/include/tune-cortexa9.inc

PREFERRED_PROVIDER_virtual/kernel ??= "linux-esc"

PREFERRED_PROVIDER_u-boot ?= "u-boot-esc"
PREFERRED_PROVIDER_virtual/bootloader ?= "u-boot-esc"

PREFERRED_VERSION_linux-esc ?= "4.1"

KERNEL_DEVICETREE = "imx6q-esc.dtb"

UBOOT_MACHINE ?= "mx6esc_defconfig"
UBOOT_MAKE_TARGET = "all"
UBOOT_SUFFIX = "img"
SPL_BINARY = "SPL"
WKS_FILE = "imx-uboot-spl-bootpart.wks"

SERIAL_CONSOLE = "115200 ttymxc0"

MACHINE_FIRMWARE_append_mx6 = " linux-firmware-ath6k"

MACHINE_FEATURES += " pci wifi bluetooth"
```
